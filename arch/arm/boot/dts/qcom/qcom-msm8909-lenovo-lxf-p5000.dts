// SPDX-License-Identifier: GPL-2.0-only

/dts-v1/;

#include "qcom-msm8909-lenovo-lxf-p5x00.dtsi"

/ {
	model = "Lenovo Yoga Tab 3 8 LTE";
	compatible = "lenovo,lxf-p5000", "qcom,msm8909";
	chassis-type = "tablet";
};
