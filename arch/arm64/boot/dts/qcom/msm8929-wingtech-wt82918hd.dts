// SPDX-License-Identifier: GPL-2.0-only

/dts-v1/;

#include "msm8939-wingtech-wt82918.dtsi"
#include "msm8929.dtsi"

/ {
	model = "Lenovo Vibe K5 (Wingtech WT82918)";
	compatible = "wingtech,wt82918hd", "qcom,msm8929";
	chassis-type = "handset";
};

&touchscreen {
	touchscreen-size-x = <720>;
	touchscreen-size-y = <1280>;
};
