// SPDX-License-Identifier: GPL-2.0-only

/dts-v1/;

#include "msm8939-huawei-kiwi-common.dtsi"

/ {
    model = "Huawei Honor 5X (2GB Version)";
    compatible = "huawei,kiwi", "qcom,msm8939";
    chassis-type = "handset";
    qcom,board-id = <8007 0>, <8007 4>, <8017 0>, <8017 4>,
                    <8019 0>, <8019 4>, <8023 0>, <8023 4>,
                    <8033 0>, <8033 4>, <8039 0>, <8039 4>,
                    <8049 0>, <8049 4>, <8051 0>, <8051 4>,
                    <8054 0>, <8054 4>, <8065 0>, <8065 4>,
                    <8070 0>, <8070 4>, <8081 0>, <8081 4>,
                    <8083 0>, <8083 4>, <8097 0>, <8097 4>,
                    <8099 0>, <8099 4>, <8103 0>, <8103 4>,
                    <8116 0>, <8116 4>, <8119 0>, <8119 4>,
                    <8119 0>, <8119 4>, <8131 0>, <8131 4>;
                    
                    
    memory@80000000 {
		device_type = "memory";
		reg = <0x0 0x80000000 0x0 0x0>;//set 2GB
	};
};
