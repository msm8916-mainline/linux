// SPDX-License-Identifier: GPL-2.0-only

/dts-v1/;

#include "msm8916-samsung-cprime-common.dtsi"

/ {
	model = "Samsung Galaxy Core Prime";
	compatible = "samsung,cprime", "qcom,msm8916";
	chassis-type = "handset";
};

&mpss_mem {
	reg = <0x0 0x86800000 0x0 0x5800000>;
};
