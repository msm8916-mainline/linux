## drivers/gpu/drm/panel/msm8916-generated/Kconfig
```kconfig
menu "MSM8916 panel drivers generated with linux-mdss-dsi-panel-driver-generator"
	depends on GPIOLIB && OF && REGULATOR
	depends on DRM_MIPI_DSI

config DRM_PANEL_MSM8916_GENERATED
	tristate "Select all generated MSM8916 panel drivers by default"

config DRM_PANEL_ALCATEL_AUO_HX8394D
	tristate "Alcatel AUO HX8394D"
	default DRM_PANEL_MSM8916_GENERATED

config DRM_PANEL_ALCATEL_IDOL3_NT35596
	tristate "Alcatel IDOL3 NT35596"
	default DRM_PANEL_MSM8916_GENERATED

config DRM_PANEL_ALCATEL_IDOL3_R63315
	tristate "Alcatel IDOL3 R63315"
	default DRM_PANEL_MSM8916_GENERATED

config DRM_PANEL_ASUS_Z00L_OTM1284A
	tristate "Asus Z00L OTM1284A"
	default DRM_PANEL_MSM8916_GENERATED

config DRM_PANEL_ASUS_Z010D_R69339
	tristate "Asus Z010D R69339"
	default DRM_PANEL_MSM8916_GENERATED

config DRM_PANEL_HUAWEI_BOE_OTM8019A
	tristate "Huawei BOE OTM8019A"
	default DRM_PANEL_MSM8916_GENERATED

config DRM_PANEL_HUAWEI_KIWI_CMI_NT35532
	tristate "Huawei KIWI CMI NT35532"
	default DRM_PANEL_MSM8916_GENERATED

config DRM_PANEL_HUAWEI_KIWI_TIANMA_NT35596
	tristate "Huawei KIWI TIANMA NT35596"
	default DRM_PANEL_MSM8916_GENERATED

config DRM_PANEL_HUAWEI_TIANMA_NT35521
	tristate "Huawei TIANMA NT35521"
	default DRM_PANEL_MSM8916_GENERATED

config DRM_PANEL_LONGCHEER_BOOYI_OTM1287
	tristate "Longcheer BOOYI OTM1287"
	default DRM_PANEL_MSM8916_GENERATED

config DRM_PANEL_LONGCHEER_DIJING_ILI9881C
	tristate "Longcheer DIJING ILI9881C"
	default DRM_PANEL_MSM8916_GENERATED

config DRM_PANEL_LONGCHEER_TRULY_NT35695
	tristate "Longcheer TRULY NT35695"
	default DRM_PANEL_MSM8916_GENERATED

config DRM_PANEL_LONGCHEER_TRULY_OTM1288A
	tristate "Longcheer TRULY OTM1288A"
	default DRM_PANEL_MSM8916_GENERATED

config DRM_PANEL_LONGCHEER_YUSHUN_NT35520
	tristate "Longcheer YUSHUN NT35520"
	default DRM_PANEL_MSM8916_GENERATED

config DRM_PANEL_MOTOROLA_HARPIA_BOE
	tristate "Motorola HARPIA BOE"
	default DRM_PANEL_MSM8916_GENERATED

config DRM_PANEL_MOTOROLA_HARPIA_TIANMA
	tristate "Motorola HARPIA TIANMA"
	default DRM_PANEL_MSM8916_GENERATED

config DRM_PANEL_MOTOROLA_OSPREY_INX
	tristate "Motorola OSPREY INX"
	default DRM_PANEL_MSM8916_GENERATED

config DRM_PANEL_MOTOROLA_SURNIA_BOE
	tristate "Motorola SURNIA BOE"
	default DRM_PANEL_MSM8916_GENERATED

config DRM_PANEL_SAMSUNG_EA8061_AMS549BU19_ID400418
	tristate "Samsung EA8061 AMS549BU19 ID400418"
	default DRM_PANEL_MSM8916_GENERATED

config DRM_PANEL_SAMSUNG_EA8061V_AMS497EE01
	tristate "Samsung EA8061V AMS497EE01"
	default DRM_PANEL_MSM8916_GENERATED

config DRM_PANEL_SAMSUNG_HX8389C_GH9607501A
	tristate "Samsung HX8389C GH9607501A"
	default DRM_PANEL_MSM8916_GENERATED

config DRM_PANEL_SAMSUNG_NT51017_B4P096WX5VP09
	tristate "Samsung NT51017 B4P096WX5VP09"
	default DRM_PANEL_MSM8916_GENERATED

config DRM_PANEL_SAMSUNG_S6288A0
	tristate "Samsung S6288A0"
	default DRM_PANEL_MSM8916_GENERATED

config DRM_PANEL_SAMSUNG_S6D2AA0X62_LPM053A250A
	tristate "Samsung S6D2AA0X62 LPM053A250A"
	default DRM_PANEL_MSM8916_GENERATED

config DRM_PANEL_SAMSUNG_S6D78A0_GH9607501A
	tristate "Samsung S6D78A0 GH9607501A"
	default DRM_PANEL_MSM8916_GENERATED

config DRM_PANEL_SAMSUNG_S6D7AA0_LSL080AL03
	tristate "Samsung S6D7AA0 LSL080AL03"
	default DRM_PANEL_MSM8916_GENERATED

config DRM_PANEL_SAMSUNG_S6D7AA0_LTL101AT01
	tristate "Samsung S6D7AA0 LTL101AT01"
	default DRM_PANEL_MSM8916_GENERATED

config DRM_PANEL_SAMSUNG_S6E3FA2_AMS549EH01
	tristate "Samsung S6E3FA2 AMS549EH01"
	default DRM_PANEL_MSM8916_GENERATED

config DRM_PANEL_SAMSUNG_S6E88A0_AMS427AP24
	tristate "Samsung S6E88A0 AMS427AP24"
	default DRM_PANEL_MSM8916_GENERATED

config DRM_PANEL_SAMSUNG_S6E8AA5X01_AMS497HY01
	tristate "Samsung S6E8AA5X01 AMS497HY01"
	default DRM_PANEL_MSM8916_GENERATED

config DRM_PANEL_SAMSUNG_S6E8AA5X01_AMS520KT01
	tristate "Samsung S6E8AA5X01 AMS520KT01"
	default DRM_PANEL_MSM8916_GENERATED

config DRM_PANEL_SAMSUNG_SC7798A_BV045WVM
	tristate "Samsung SC7798A BV045WVM"
	default DRM_PANEL_MSM8916_GENERATED

config DRM_PANEL_SAMSUNG_TC358764_LTL101AL06
	tristate "Samsung TC358764 LTL101AL06"
	default DRM_PANEL_MSM8916_GENERATED

config DRM_PANEL_WINGTECH_AUO_NT35521
	tristate "Wingtech AUO NT35521"
	default DRM_PANEL_MSM8916_GENERATED

config DRM_PANEL_WINGTECH_AUO_R61308
	tristate "Wingtech AUO R61308"
	default DRM_PANEL_MSM8916_GENERATED

config DRM_PANEL_WINGTECH_BOE_NT35521S
	tristate "Wingtech BOE NT35521S"
	default DRM_PANEL_MSM8916_GENERATED

config DRM_PANEL_WINGTECH_EBBG_OTM1285A
	tristate "Wingtech EBBG OTM1285A"
	default DRM_PANEL_MSM8916_GENERATED

config DRM_PANEL_WINGTECH_QIMEI_ILI9881
	tristate "Wingtech QIMEI ILI9881"
	default DRM_PANEL_MSM8916_GENERATED

config DRM_PANEL_WINGTECH_SHARP_R69431
	tristate "Wingtech SHARP R69431"
	default DRM_PANEL_MSM8916_GENERATED

config DRM_PANEL_WINGTECH_TIANMA_HX8394D
	tristate "Wingtech TIANMA HX8394D"
	default DRM_PANEL_MSM8916_GENERATED

config DRM_PANEL_WINGTECH_YASSY_ILI9881
	tristate "Wingtech YASSY ILI9881"
	default DRM_PANEL_MSM8916_GENERATED

endmenu
```
