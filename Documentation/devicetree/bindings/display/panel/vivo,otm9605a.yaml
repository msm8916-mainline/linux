## Documentation/devicetree/bindings/display/panel/vivo,otm9605a.yaml
```yaml
# SPDX-License-Identifier: (GPL-2.0-only OR BSD-2-Clause)
%YAML 1.2
---
$id: http://devicetree.org/schemas/display/panel/vivo,otm9605a.yaml#
$schema: http://devicetree.org/meta-schemas/core.yaml#

title: vivo OTM9605A based panel

maintainers:
  - Qing Xian <qw52554@outlook.com>

allOf:
  - $ref: panel-common.yaml#

properties:
  compatible:
    enum:
      - vivo,otm9605a
      - vivo,otm9605a-baoming
      - vivo,otm9605a-boenew

  reg: true
  reset-gpios: true
  vdd-supply: true
  vddio-supply: true
  backlight: true

required:
  - compatible
  - reg
  - vdd-supply
  - vddio-supply

additionalProperties: false
...
```

## Documentation/devicetree/bindings/iio/light/amstaos,tcs3472.yaml
```yaml
# SPDX-License-Identifier: (GPL-2.0 OR BSD-2-Clause)
%YAML 1.2
---
$id: http://devicetree.org/schemas/iio/light/amstaos,tcs3472.yaml#
$schema: http://devicetree.org/meta-schemas/core.yaml#

title: AMS/TAOS TCS3472/TMD3782 Color Light and Proximity Sensor

maintainers:
  - Peter Meerwald <pmeerw@pmeerw.net>

description: |
  RGBC color light-to-digital converter with optional proximity detection.
  TCS3472 provides 4-channel RGBC sensing. TMD3782 adds an integrated
  proximity detector with IR LED driver. The TMD3782 family also includes
  TMD37825/TMD37827 variants at I2C address 0x29 (same die, untested).

  TCS3472 datasheet:
    https://ams.com/documents/20143/36005/TCS3472_DS000190_1-00.pdf

  TMD3782 datasheet:
    https://media.digikey.com/pdf/Data%20Sheets/Austriamicrosystems%20PDFs/TMD3782_v2.pdf

properties:
  compatible:
    enum:
      - amstaos,tcs3472
      - amstaos,tmd3782

  reg:
    maxItems: 1

  interrupts:
    maxItems: 1

  vdd-supply:
    description: Regulator that provides power to the sensor

  vddio-supply:
    description: Regulator that provides power to the I2C bus

  vled-supply:
    description: Regulator that provides power to the proximity IR LED

  amstaos,proximity-pulse-count:
    description:
      Number of proximity IR LED pulses per measurement cycle.
      Higher values increase signal strength at the cost of power.
    $ref: /schemas/types.yaml#/definitions/uint32
    minimum: 1
    maximum: 255
    default: 8

required:
  - compatible
  - reg

additionalProperties: false

examples:
  - |
    #include <dt-bindings/interrupt-controller/irq.h>

    i2c {
        #address-cells = <1>;
        #size-cells = <0>;

        light-sensor@39 {
                compatible = "amstaos,tmd3782";
                reg = <0x39>;
                interrupts = <113 IRQ_TYPE_LEVEL_LOW>;
                vdd-supply = <&reg_prox_vdd>;
                vddio-supply = <&pm8916_l5>;
                vled-supply = <&reg_prox_led>;
                amstaos,proximity-pulse-count = <6>;
        };
    };
...
```

## Documentation/devicetree/bindings/iio/light/capella,cm36283.yaml
```yaml
# SPDX-License-Identifier: (GPL-2.0 OR BSD-2-Clause)
%YAML 1.2
---
$id: http://devicetree.org/schemas/iio/light/capella,cm36283.yaml#
$schema: http://devicetree.org/meta-schemas/core.yaml#

title: Capella CM36283 I2C Ambient Light and Proximity sensor

maintainers:
  - Erikas Bitovtas <xerikasxx@gmail.com>

properties:
  compatible:
    enum:
      - capella,cm36283
      - capella,cm36686
      - capella,cm36672p

  reg:
    maxItems: 1

  interrupts:
    maxItems: 1

  vdd-supply:
    description:
      Regulator that provides power to the sensor.

  vddio-supply:
    description:
      Regulator used to power IO and I2C bus.

  vled-supply:
    description:
      Regulator used to power proximity LED for cm36686 and cm36672p

  proximity-near-level: true

  capella,proximity-led-current:
    description:
      Current for proximity IR LED used in cm36686 and cm36672p (in uA)

allOf:
  - $ref: ../common.yaml#
  - if:
      properties:
        compatible:
          enum:
            - capella,cm36686
            - capella,cm36672p

    then:
      properties:
        capella,proximity-led-current:
          enum: [ 50, 75, 100, 120, 140, 160, 180, 200 ]

    else:
      properties:
        vled-supply: false
        capella,proximity-led-current: false

additionalProperties: false

required:
  - compatible
  - reg

examples:
  - |
    #include <dt-bindings/interrupt-controller/irq.h>

    i2c {
      #address-cells = <1>;
      #size-cells = <0>;

      light-sensor@60 {
        compatible = "capella,cm36686";
        reg = <0x60>;

        vdd-supply = <&pm8916_l8>;
        vddio-supply = <&pm8916_l6>;

        interrupts-extended = <&tlmm 113 IRQ_TYPE_LEVEL_LOW>;

        proximity-near-level = <30>;
        capella,proximity-far-level = <16>;
      };
    };
```

## Documentation/devicetree/bindings/iio/light/dynaimage,ap3216c.yaml
```yaml
# SPDX-License-Identifier: (GPL-2.0-only OR BSD-2-Clause)
%YAML 1.2
---
$id: http://devicetree.org/schemas/iio/light/dynaimage,ap3216c.yaml#
$schema: http://devicetree.org/schemas/meta-schemas/core.yaml#

title: DynaImage AP3216C / AP3426 Ambient Light and Proximity Sensor

maintainers:
  - Vladislav Dubrovin <foxy9855@gmail.com>

description: |
  DynaImage AP3216C and AP3426 are integrated digital ambient light,
  proximity, and IR sensor.

  Specifications about the devices can be found at:
  https://github.com/RT-Thread-packages/ap3216c/blob/master/ap3216c_datasheet.pdf

properties:
  compatible:
    oneOf:
      - items:
          - const: dynaimage,ap3426
          - const: dynaimage,ap3216c
      - enum:
          - dynaimage,ap3216c
          - dynaimage,ap3426

  reg:
    maxItems: 1

  interrupts:
    maxItems: 1

  vdd-supply:
    description: Regulator powering the sensor VDD pin.

  vddio-supply:
    description: Regulator powering the sensor VDDIO pin.

  proximity-near-level:
    $ref: /schemas/types.yaml#/definitions/uint32
    description:
      Raw proximity threshold level above which an object is considered "near".
    default: 300

required:
  - compatible
  - reg

additionalProperties: false

examples:
  - |
    #include <dt-bindings/interrupt-controller/irq.h>

    i2c {
        #address-cells = <1>;
        #size-cells = <0>;

        light-sensor@1e {
            compatible = "dynaimage,ap3426", "dynaimage,ap3216c";
            reg = <0x1e>;

            interrupt-parent = <&tlmm>;
            interrupts = <113 IRQ_TYPE_EDGE_FALLING>;
            vdd-supply = <&pm8916_l17>;
            vddio-supply = <&pm8916_l6>;
            proximity-near-level = <300>;

            pinctrl-0 = <&als_int_default>;
            pinctrl-names = "default";
        };
    };
```

## Documentation/devicetree/bindings/media/qcom,msm8939-venus.yaml
```yaml
# SPDX-License-Identifier: (GPL-2.0-only OR BSD-2-Clause)
%YAML 1.2
---
$id: http://devicetree.org/schemas/media/qcom,msm8939-venus.yaml#
$schema: http://devicetree.org/meta-schemas/core.yaml#

title: Qualcomm MSM8939 Venus video encode and decode accelerators

maintainers:
  - Erikas Bitovtas <xerikasxx@gmail.com>

description: |
  The Venus IP is a video encode and decode accelerator present
  on Qualcomm platforms

allOf:
  - $ref: qcom,venus-common.yaml#

properties:
  compatible:
    const: qcom,msm8939-venus

  power-domains:
    maxItems: 1

  clocks:
    maxItems: 3

  clock-names:
    items:
      - const: core
      - const: iface
      - const: bus

  iommus:
    maxItems: 1

  video-decoder:
    type: object

    properties:
      compatible:
        const: venus-decoder

      clocks:
        maxItems: 2

      clock-names:
        items:
          - const: core0
          - const: core1

      power-domains:
        maxItems: 2

      power-domain-names:
        items:
          - const: core0
          - const: core1

    required:
      - compatible
      - clocks
      - clock-names
      - power-domains
      - power-domain-names

    additionalProperties: false

required:
  - compatible
  - iommus
  - video-decoder

unevaluatedProperties: false

examples:
  - |
    #include <dt-bindings/interrupt-controller/arm-gic.h>
    #include <dt-bindings/clock/qcom,gcc-msm8939.h>

    video-codec@1d00000 {
        compatible = "qcom,msm8939-venus";
        reg = <0x01d00000 0xff000>;
        interrupts = <GIC_SPI 44 IRQ_TYPE_LEVEL_HIGH>;
        clocks = <&gcc GCC_VENUS0_VCODEC0_CLK>,
                 <&gcc GCC_VENUS0_AHB_CLK>,
                 <&gcc GCC_VENUS0_AXI_CLK>;
        clock-names = "core", "iface", "bus";
        power-domains = <&gcc VENUS_GDSC>;
        iommus = <&apps_iommu 5>;
        memory-region = <&venus_mem>;

        video-decoder {
          compatible = "venus-decoder";
          clocks = <&gcc GCC_VENUS0_CORE0_VCODEC0_CLK>,
                   <&gcc GCC_VENUS0_CORE1_VCODEC0_CLK>;
          clock-names = "core0", "core1";
          power-domains = <&gcc VENUS_CORE0_GDSC>,
                          <&gcc VENUS_CORE1_GDSC>;
          power-domain-names = "vcodec_core0", "vcodec_core1";
        };
    };
```
